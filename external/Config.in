## external/Config.in
```kconfig
source "$BR2_EXTERNAL_AULOS_PATH/package/cava/Config.in"
source "$BR2_EXTERNAL_AULOS_PATH/package/cli-visualizer/Config.in"
source "$BR2_EXTERNAL_AULOS_PATH/package/cmus/Config.in"
source "$BR2_EXTERNAL_AULOS_PATH/package/libiniparser/Config.in"
source "$BR2_EXTERNAL_AULOS_PATH/package/tock/Config.in"
source "$BR2_EXTERNAL_AULOS_PATH/package/tty-clock/Config.in"
```

## external/package/cava/Config.in
```kconfig
config BR2_PACKAGE_CAVA
	bool "cava"
	help
	  Cava is a bar spectrum audio visualizer for
	  terminal (ncurses) or desktop (SDL).

	  https://github.com/karlstav/cava/
```

## external/package/cli-visualizer/Config.in
```kconfig
config BR2_PACKAGE_CLI_VISUALIZER
	bool "cli-visualizer"
	select BR2_PACKAGE_FFTW_SINGLE
	select BR2_PACKAGE_NCURSES
	help
	  Command line visualizer. Supports mpd, with experimental 
	  support for alsa and pulseaudio.

	  https://github.com/dpayne/cli-visualizer
```

## external/package/cmus/Config.in
```kconfig
config BR2_PACKAGE_CMUS
	bool "cmus"
	select BR2_PACKAGE_NCURSES
	help
	  Small, fast and powerful console music player for 
	  Unix-like operating systems. 

	  https://cmus.github.io/
```

## external/package/libiniparser/Config.in
```kconfig
config BR2_PACKAGE_LIBINIPARSER
	bool "libiniparser"
	help
	  This modules offers parsing of ini files from C.

	  https://gitlab.com/iniparser/iniparser
```

## external/package/tock/Config.in
```kconfig
config BR2_PACKAGE_TOCK
	bool "tock"
	depends on BR2_PACKAGE_HOST_RUSTC_TARGET_ARCH_SUPPORTS
	select BR2_PACKAGE_NCURSES
	select BR2_PACKAGE_HOST_RUSTC
	help
	  A digital clock for the terminal, inspired by tty-clock 

	  https://github.com/nwtnni/tock
```

## external/package/tty-clock/Config.in
```kconfig
config BR2_PACKAGE_TTY-CLOCK
	bool "tty-clock"
	select BR2_PACKAGE_NCURSES
	help
	  Clock using lib ncurses 

	  https://github.com/xorg62/tty-clock
```
